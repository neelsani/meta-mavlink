## conf/layer.conf
```bitbake
# We have a conf and classes directory, add to BBPATH
BBPATH .= ":${LAYERDIR}"

# We have recipes-* directories, add to BBFILES
BBFILES += "${LAYERDIR}/recipes-*/*/*.bb \
            ${LAYERDIR}/recipes-*/*/*.bbappend"

BBFILE_COLLECTIONS += "meta-mavlink"
BBFILE_PATTERN_meta-mavlink = "^${LAYERDIR}/"
BBFILE_PRIORITY_meta-mavlink = "6"

LAYERDEPENDS_meta-mavlink = "core openembedded-layer meta-python"
LAYERSERIES_COMPAT_meta-mavlink = "scarthgap"
```
